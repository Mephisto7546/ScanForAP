## main/Kconfig.projbuild
```kconfig
menu "Example Configuration"

    config BLINK_GPIO
        int "Blink GPIO number"
        range 0 34
        default 2
        help
            GPIO number (IOxx) to blink on and off.


endmenu
```
